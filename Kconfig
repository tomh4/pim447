## Kconfig
```kconfig
# 2024 t0bybr

config ZMK_PIMORONI_PIM447
  bool "Pimoroni PIM447 Trackball support"
  select ZMK_MOUSE
  select I2C
  select GPIO
  help
    Enable driver for Pimoroni  Trackball.

if ZMK_PIMORONI_PIM447

  config ZMK_PIMORONI_PIM447_MOUSE_MAX_SPEED
    int "Amount of scaling speed"
    default 25
  
  config ZMK_PIMORONI_PIM447_MOUSE_MAX_TIME
    int "Amount of milliseconds the mouse max time"
    default 5

  config ZMK_PIM447_BEHAVIORS
    bool "Enable Pimoroni PIM447 Trackball Actions behavior"
    depends on ZMK_PIMORONI_PIM447
    select ZMK_BEHAVIORS
    default y
    help
      Enable Pimoroni PIM447 Trackball behaviors.

endif # ZMK_PIMORONI_PIM447
```
